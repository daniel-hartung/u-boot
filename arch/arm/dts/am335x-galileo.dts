/*
 * Copyright (C) 2012 Texas Instruments Incorporated - http://www.ti.com/
 *
 * This program is free software; you can redistribute it and/or modify
 * it under the terms of the GNU General Public License version 2 as
 * published by the Free Software Foundation.
 */
/dts-v1/;

#include "am33xx.dtsi"
#include "am335x-galileo-common.dtsi"

/ {
	model = "Galileo";
	compatible = "ti,am335x-galileo", "ti,am33xx";
	chosen {
		stdout-path = &uart0;
		tick-timer = &timer2;
	};
};

