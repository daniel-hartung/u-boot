## configs/ams1xx_defconfig
```kconfig
CONFIG_ARM=y
CONFIG_ARCH_OMAP2PLUS=y
CONFIG_SPL_GPIO_SUPPORT=y
CONFIG_SPL_LIBCOMMON_SUPPORT=y
CONFIG_SPL_LIBGENERIC_SUPPORT=y
CONFIG_AM33XX=y
CONFIG_TARGET_GALILEO_33XX=y
CONFIG_SPL_MMC_SUPPORT=y
CONFIG_SPL_SERIAL_SUPPORT=y
CONFIG_SPL=y
CONFIG_SPL_FAT_SUPPORT=y
CONFIG_SPL_LIBDISK_SUPPORT=y
CONFIG_SMBIOS_PRODUCT_NAME="cm_t335"
CONFIG_DISTRO_DEFAULTS=y
# CONFIG_USE_BOOTCOMMAND is not set
CONFIG_SYS_CONSOLE_INFO_QUIET=y
CONFIG_VERSION_VARIABLE=y
CONFIG_SPL_EXT_SUPPORT=y
CONFIG_SPL_I2C_SUPPORT=y
CONFIG_SPL_MTD_SUPPORT=y
CONFIG_SPL_POWER_SUPPORT=y
CONFIG_SPL_WATCHDOG_SUPPORT=y
# CONFIG_SPL_AM33XX_ENABLE_RTC32K_OSC is not set
CONFIG_SYS_PROMPT="GALILEO-33XX test #"
CONFIG_CMD_ASKENV=y
CONFIG_CMD_EEPROM=y
CONFIG_CMD_EEPROM_LAYOUT=y
CONFIG_EEPROM_LAYOUT_HELP_STRING="v2, v3"
# CONFIG_CMD_FLASH is not set
CONFIG_CMD_GPIO=y
CONFIG_CMD_I2C=y
CONFIG_CMD_MMC=y
CONFIG_CMD_NAND=y
CONFIG_CMD_SETEXPR=y
CONFIG_CMD_EXT4_WRITE=y
CONFIG_CMD_MTDPARTS=y
CONFIG_MTDIDS_DEFAULT="nand0=nand"
CONFIG_MTDPARTS_DEFAULT="mtdparts=nand:128k(spl0),128k(spl1),128k(res0),128k(res1),1m(res2),1m(u-boot0),1m(res3),128k(u-boot-env0),128k(u-boot-env1),256k(res4),6m(kernelA),6m(kernelB),256k(dtbA),256k(dtbB),1536k(res5),-(ubi)"
CONFIG_ENV_IS_IN_NAND=y
CONFIG_CMD_PCA953X=y
CONFIG_LED_STATUS=y
CONFIG_LED_STATUS_GPIO=y
CONFIG_LED_STATUS0=y
CONFIG_LED_STATUS_BIT=64
CONFIG_LED_STATUS_BOOT_ENABLE=y
CONFIG_LED_STATUS_BOOT=0
CONFIG_MMC_OMAP_HS=y
CONFIG_NAND=y
# CONFIG_SPL_NAND_AM33XX_BCH is not set
CONFIG_MII=y
CONFIG_DRIVER_TI_CPSW=y
CONFIG_FAT_WRITE=y
CONFIG_SMBIOS_MANUFACTURER="compulab"
# configs related to verified boot
CONFIG_ENABLE_VBOOT=y
CONFIG_RSA=y
CONFIG_FIT=y
CONFIG_FIT_SIGNATURE=y
CONFIG_OF_CONTROL=y
CONFIG_OF_SEPARATE=y
CONFIG_OF_LIBFDT=y
CONFIG_CMD_IMI=y
# CONFIG_FIT_VERBOSE is not set
```

## fit/galileo.its
```
/*
 * Simple U-boot uImage source file containing a single kernel
 */

/dts-v1/;

/ {
	description = "Simple image with single Linux kernel";
	#address-cells = <1>;

	images {
		kernel@1 {
			description = "Galileo Linux kernel";
			data = /incbin/("/home/daniel/yocto-ams1xx/build/tmp/deploy/images/ams1xx/zImage");
			type = "kernel";
			arch = "arm";
			os = "linux";
			compression = "none";
			load = <0x82000000>; 
			entry = <0x82000000>;
			hash@1 {
				algo = "sha256";
			};
		};
		fdt@1 {
			description = "Flattened Device Tree";
			data = /incbin/("/home/daniel/yocto-ams1xx/build/tmp/deploy/images/ams1xx/am335x-galileo-33xx.dtb");
			type = "flat_dt";
			arch = "arm";
			//load = <0x88000000>;
			compression = "none";
			hash@1 {
				algo = "sha256";
			};
		};
	};

	configurations {
		default = "config@1";
		config@1 {
			description = "Boot Galileo Linux kernel";
			kernel = "kernel@1";
			fdt = "fdt@1";
			signature@1{
                                algo = "sha256,rsa2048";
                                key-name-hint = "dev_key";
                                sign-images = "fdt", "kernel";
                        };
		};
	};
};
```
